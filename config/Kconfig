## config/Kconfig
```kconfig
menu "Velvet Kernel Configuration"

source "config/kernel/drivers/uart/Kconfig"

endmenu
```

## config/kernel/drivers/uart/Kconfig
```kconfig
menu "UART KERNEL CONFIGURATION"

config DISABLE_SERIAL_CON
	bool "Disable Serial Console (serial_con)"
	default n
	help
		This disables the serial_con
endmenu
```
